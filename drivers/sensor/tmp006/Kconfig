## drivers/sensor/tmp006/Kconfig
```kconfig
# Kconfig - TMP006 temperature sensor configuration options

#
# Copyright (c) 2017 Texas Instruments Incorporated
#
# SPDX-License-Identifier: Apache-2.0
#

menuconfig TMP006
	bool
	prompt "TMP006 Temperature Sensor"
	depends on SENSOR && I2C
	default n
	help
	Enable driver for TMP006 infrared thermopile sensors.

config TMP006_NAME
	string
	prompt "Driver name"
	default "TEMP_0"
	depends on TMP006
	help
	Device name with which the TMP006 sensor is identified.

config TMP006_I2C_ADDR
	hex "I2C address for TMP006"
	depends on TMP006
	default 0x41
	help
	I2C address of the TMP006 sensor.

config TMP006_I2C_MASTER_DEV_NAME
	string
	prompt "I2C master where TMP006 is connected"
	depends on TMP006
	default "I2C_0"
	help
	Specify the device name of the I2C master device to which the
	TMP006 chip is connected.
```

## samples/net/sockets/echo/boards/cc3220sf_launchxl.conf
```kconfig
# Networking Config:
CONFIG_NETWORKING=y
CONFIG_NET_IPV4=y
CONFIG_NET_IPV6=n
CONFIG_NET_SOCKETS=y

# Enable SimpleLink WiFi Driver and Socket Offload
CONFIG_WIFI=y
CONFIG_WIFI_SIMPLELINK=y
CONFIG_NET_OFFLOAD=y

# Disable init_net_app from overriding our IPV4 address
CONFIG_NET_CONFIG_SETTINGS=n
CONFIG_NET_CONFIG_MY_IPV4_ADDR=""
CONFIG_NET_CONFIG_PEER_IPV4_ADDR=""

# Debugging
CONFIG_XIP=n
CONFIG_NET_LOG=y
CONFIG_SYS_LOG_WIFI_LEVEL=4
CONFIG_DEBUG=y
CONFIG_SYS_LOG=y
CONFIG_ASSERT=y
```
